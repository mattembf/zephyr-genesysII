## prj.conf
```kconfig
CONFIG_STDOUT_CONSOLE=y
CONFIG_BOOT_BANNER=n
# enable to use thread names
CONFIG_THREAD_NAME=y
CONFIG_SCHED_CPU_MASK=y
CONFIG_SCHED_DEADLINE=y
#CONFIG_{NO,DEBUG,SPEED,SIZE}_OPTIMIZATIONS
CONFIG_NO_OPTIMIZATIONS=y
CONFIG_SOC_SERIES_PROVIDE_HW_CONTEXT_STACK=n
CONFIG_SOC_SERIES_PROVIDE_HW_CONTEXT_UNSTACK=n
CONFIG_SOC_SERIES_CVA6_PROVIDE_TEST_POWEROFF=n
CONFIG_SOC_SERIES_CVA6_PROVIDE_FPGA_POWEROFF=y
CONFIG_SCHED_DUMB=y
CONFIG_TRACING=y
CONFIG_PERCEPIO_TRACERECORDER=y
CONFIG_PERCEPIO_TRC_START_MODE_START=y
CONFIG_PERCEPIO_TRC_CFG_STREAM_PORT_RINGBUFFER=y
CONFIG_PERCEPIO_TRC_CFG_STREAM_PORT_RINGBUFFER_SIZE=40960
CONFIG_PERCEPIO_TRC_CFG_CTRL_TASK_PRIORITY=7
#CONFIG_PERCEPIO_TRC_CFG_CTRL_TASK_DELAY=10500
```

## src/main.c
```c
#include <zephyr/kernel.h>
#include <zephyr/sys/printk.h>
#include <zephyr/sys/poweroff.h>

/* Definizione delle dimensioni dello stack per i thread */
#define STACK_SIZE 2048

/* Definizione delle priorità dei thread (valore minore = maggiore priorità) */
#define THREAD1_PRIORITY 5
#define THREAD2_PRIORITY 5
#define FAKE_IDLE_PRIORITY 10
#define NUM_LOOP 10

/* Definizione delle strutture dati per i thread */
K_THREAD_STACK_DEFINE(thread1_stack, STACK_SIZE);
K_THREAD_STACK_DEFINE(thread2_stack, STACK_SIZE);
K_THREAD_STACK_DEFINE(idle_stack, STACK_SIZE);
struct k_thread thread1_data, thread2_data, fake_idle;
int end_loop = 1, end_t = 1;
uint64_t mret_start,mret_end;

void my_timer_handler(struct k_timer *dummy)
{
	//printf("interrupt\n");
	end_loop = 0;
	ARG_UNUSED(dummy);
}

/*void fake_idle_thread(void *arg1,void *arg2,void *arg3){
	ARG_UNUSED(arg1);
	ARG_UNUSED(arg2);
	ARG_UNUSED(arg3);
	while(end_t);
}*/

K_TIMER_DEFINE(my_timer, my_timer_handler, NULL);


void thread1(void *arg1, void *arg2, void *arg3) {
   while(end_t){
		//printf("t1 sleeping\n");
		k_sleep(K_MSEC(50));
	}
	printf("t fine\n");
	ARG_UNUSED(arg1);
	ARG_UNUSED(arg2);
	ARG_UNUSED(arg3);
}

static inline uint64_t read_mret(void) {
    uint64_t v3;
    __asm__ volatile ("csrr %0, mhpmcounter3" : "=r"(v3));
    return v3;
}

static inline void enable_pmc(void) {
    uint64_t val;
    __asm__ volatile ("csrrc %0, mcountinhibit, %1" : "=r"(val) : "r"(1 << 3));
}

int main(void) {
	k_sleep(K_MSEC(1));
	//enable_pmc();
	//__asm__ volatile ("csrw mhpmevent3, 28");
    k_tid_t t1 = k_thread_create(&thread1_data, thread1_stack, STACK_SIZE,
                                   thread1, NULL, NULL, NULL,
                                   THREAD1_PRIORITY, 0, K_NO_WAIT);
	k_thread_name_set(t1,"T1");
	/*k_tid_t idle_t = k_thread_create(&fake_idle, idle_stack, STACK_SIZE,
                                   fake_idle_thread, NULL, NULL, NULL,
                                   FAKE_IDLE_PRIORITY, 0, K_NO_WAIT);	
	k_thread_name_set(idle_t,"Idle fake");	*/						   						   
	mret_start = read_mret();
	printf("start\n");
	for(int i=0;i<NUM_LOOP;i++){
		//printf("loop %d\n",i);
		end_loop = 1;
		k_timer_start(&my_timer, K_MSEC(100), K_NO_WAIT);
		while(end_loop){
			//printf("main sleeping\n");
			k_sleep(K_MSEC(50));

		}
	}
	printf("fine main loop\n");
	end_t = 0;
	k_thread_join(t1,K_FOREVER);
	//k_thread_join(idle_t,K_FOREVER);
	mret_end = read_mret();
	printf("Stalli mret: %llu\n",mret_end-mret_start);
	z_sys_poweroff();

}
```
