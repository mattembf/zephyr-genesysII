## boards/digilent/genesysII/Kconfig.genesysII
```kconfig
# Copyright 2024 CISPA Helmholtz Center for Information Security gGmbH
# SPDX-License-Identifier: Apache-2.0
config BOARD_GENESYSII
	select SOC_CV64A6
	select SOC_SERIES_CVA6_PROVIDE_TEST_POWEROFF
```

## boards/digilent/genesysII/board.yml
```yaml
# Copyright 2024 CISPA Helmholtz Center for Information Security gGmbH
# SPDX-License-Identifier: Apache-2.0
board:
  name: genesysII
  vendor: digilent
  socs:
    - name: cv64a6
```

## soc/cva6/Kconfig.soc
```kconfig
#Copyright 2024 CISPA Helmholtz Center for Information Security gGmbH
#SPDX-License-Identifier: Apache-2.0

config SOC_FAMILY_OPENHWGROUP_CVA6
	bool

config SOC_FAMILY
	default "openhwgroup_cva6" if SOC_FAMILY_OPENHWGROUP_CVA6

rsource "*/Kconfig.soc"
```

## soc/openhwgroup/cva6/Kconfig.defconfig
```kconfig
# Copyright (c) 2024 CISPA Helmholtz Center for Information Security gGmbH
# SPDX-License-Identifier: Apache-2.0

if SOC_FAMILY_OPENHWGROUP_CVA6

rsource "*/Kconfig.defconfig"

if SOC_SERIES_CVA6

config SYS_CLOCK_HW_CYCLES_PER_SEC
	default 25000000

config RISCV_SOC_INTERRUPT_INIT
	default y

config RISCV_GP
	default y

config 2ND_LVL_ISR_TBL_OFFSET
	default 13

config 2ND_LVL_INTR_00_OFFSET
	default 11

config MAX_IRQ_PER_AGGREGATOR
	default 186

config NUM_IRQS
	default 186
	
config RISCV_SOC_CONTEXT_SAVE
	default n

endif # SOC_SERIES_CVA6


endif # SOC_FAMILY_OPENHWGROUP_CVA6
```
